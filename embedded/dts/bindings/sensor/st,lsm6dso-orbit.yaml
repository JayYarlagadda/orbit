## embedded/dts/bindings/sensor/st,lsm6dso-orbit.yaml
```yaml
description: Orbit register-level LSM6DSO SPI IMU

compatible: "st,lsm6dso-orbit"

include: spi-device.yaml

properties:
  int-gpios:
    type: phandle-array
    required: true
    description: Data-ready interrupt line (INT1, active high)
```

## embedded/west.yml
```yaml
# Orbit embedded west workspace manifest.
# Initialize from this directory:
#   west init -l .
#   west update
manifest:
  version: "0.13"

  defaults:
    remote: zephyrproject

  remotes:
    - name: zephyrproject
      url-base: https://github.com/zephyrproject-rtos

  projects:
    - name: zephyr
      remote: zephyrproject
      revision: v3.7.0
      import: true

  self:
    path: .
```
